## meta-mender-technexion/conf/layer.conf
```bitbake
# Copyright 2020 TechNexion

# We have a conf and classes directory, add to BBPATH
BBPATH .= ":${LAYERDIR}"

# We have recipes-* directories, add to BBFILES
BBFILES += "${LAYERDIR}/recipes-*/*/*.bb \
	${LAYERDIR}/recipes-*/*/*.bbappend"

BBFILE_COLLECTIONS += "mender-technexion"
BBFILE_PATTERN_mender-technexion = "^${LAYERDIR}/"
BBFILE_PRIORITY_mender-technexion = "10"

LAYERSERIES_COMPAT_mender-technexion = "sumo"
```
